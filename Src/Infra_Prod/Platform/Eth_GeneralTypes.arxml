AUTOSAR XML (schema 4-2-2)
# Copyright (C) Infineon Technologies (2018)
# All rights reserved.
package /AUTOSAR_Eth_GeneralTypes/ImplementationDataTypes
  12 x impl type, all with type-emitter=BSW:
    Eth_BufIdxType: implementation-data-type=uint32
    Eth_DataType: implementation-data-type=uint8
    Eth_FilterActionType: compu {0=ETH_ADD_TO_FILTER, 1=ETH_REMOVE_FROM_FILTER}, implementation-data-type=uint32, additional-native-type-qualifier=enum
    Eth_FrameType: implementation-data-type=uint16
    Eth_ModeType: compu {0=ETH_MODE_DOWN, 1=ETH_MODE_ACTIVE}, implementation-data-type=uint32, additional-native-type-qualifier=enum
    Eth_RateRatioType: category=STRUCTURE
      element IngressTimeStampDelta: implementation-data-type=Eth_TimeIntDiffType
      element OriginTimeStampDelta: implementation-data-type=Eth_TimeIntDiffType
    Eth_ReturnType: compu {0=ETH_OK, 1=ETH_E_NOT_OK, 2=ETH_E_NO_ACCESS}, implementation-data-type=uint32, additional-native-type-qualifier=enum
    Eth_RxStatusType: compu {0=ETH_RECEIVED, 1=ETH_NOT_RECEIVED, 2=ETH_RECEIVED_MORE_DATA_AVAILABLE}, implementation-data-type=uint32, additional-native-type-qualifier=enum
    Eth_StateType: compu {0=ETH_STATE_UNINIT, 1=ETH_STATE_INIT}, implementation-data-type=uint32, additional-native-type-qualifier=enum
    Eth_TimeIntDiffType: category=STRUCTURE
      element diff: implementation-data-type=Eth_TimeStampType
      element sign: implementation-data-type=boolean
    Eth_TimeStampQualType: compu {0=ETH_VALID, 1=ETH_INVALID, 2=ETH_UNCERTAIN}, implementation-data-type=uint32, additional-native-type-qualifier=enum
    Eth_TimeStampType: category=STRUCTURE
      element nanoseconds: implementation-data-type=uint32
      element seconds: implementation-data-type=uint32
      element secondsHi: implementation-data-type=uint16
